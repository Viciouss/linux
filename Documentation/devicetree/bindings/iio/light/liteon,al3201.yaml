## Documentation/devicetree/bindings/iio/light/liteon,al3201.yaml
```yaml
# SPDX-License-Identifier: (GPL-2.0-only OR BSD-2-Clause)
%YAML 1.2
---
$id: http://devicetree.org/schemas/iio/light/liteon,al3201.yaml#
$schema: http://devicetree.org/meta-schemas/core.yaml#

title: LiteON AL3201 sensor

maintainers:
  - Martin Jücker <martin.juecker@gmail.com>

properties:
  compatible:
    const: liteon,al3201

  reg:
    maxItems: 1

required:
  - compatible
  - reg

additionalProperties: false

examples:
  - |
    i2c {
        #address-cells = <1>;
        #size-cells = <0>;

        light-sensor@1c {
            compatible = "liteon,al3201";
            reg = <0x1c>;
        };
    };
```

## Documentation/devicetree/bindings/input/immersion,isa1200.yaml
```yaml
# SPDX-License-Identifier: (GPL-2.0-only OR BSD-2-Clause)
%YAML 1.2
---
$id: http://devicetree.org/schemas/input/immersion,isa1200.yaml#
$schema: http://devicetree.org/meta-schemas/core.yaml#

title: Immersion ISA1200 Haptic Feedback Unit

maintainers:
  - Linus Walleij <linus.walleij@linaro.org>

description:
  The Immersion ISA1200 is a haptic feedback chip using two motors of
  LRA or ERM type. It can generate a PWM signal to control the motors from
  a fixed input clock, or it can amplify and modify an existing PWM
  input. It is communicating with the host system using I2C.

properties:
  compatible:
    const: immersion,isa1200

  reg:
    description: I2C address for the ISA1200

  hen-gpios:
    description: GPIO line that drives the HEN (Motor Hardware Enable) pin
      on the chip.
    maxItems: 1

  len-gpios:
    description: GPIO line that drives the LEN (LDO Enable) pin on the chip.
    maxItems: 1

  clocks:
    description: Clock that drives the chip if using the chip to generate a
      PWM from a clock. Either clocks or pwms must be defined.
    maxItems: 1

  pwms:
    description: PWM that drives the chip if using an external PWM generator.
      Either pwms or clocks must be defined.
    maxItems: 1

  isa1200,ldo-voltage:
    description: The voltage to be supplied to the motor in volts.
    minimum: 23
    maximum: 38

  isa1200,clock-divider:
    $ref: /schemas/types.yaml#/definitions/uint16
    description: The clock divider used for the incoming clock signal.
    enum:
      - 128
      - 256
      - 512
      - 1024
    default: 128

  isa1200,pll-divider:
    $ref: /schemas/types.yaml#/definitions/uint8
    description: The PLL divider used to generate the PWM signal.

  isa1200,pwm-frequency:
    $ref: /schemas/types.yaml#/definitions/uint8
    description: The frequency of the PWM signal generated by the chip.

  isa1200,pwm-duty:
    $ref: /schemas/types.yaml#/definitions/uint8
    description: The duty cycle of the PWM signal generated by the chip.

  isa1200,pwm-period:
    $ref: /schemas/types.yaml#/definitions/uint8
    description: The period of the PWM signal generated by the chip.


required:
  - compatible
  - reg
  - len-gpios
  - isa1200,ldo-voltage

additionalProperties: false

examples:
  - |
    #include <dt-bindings/gpio/gpio.h>

    i2c {
      #address-cells = <1>;
      #size-cells = <0>;

      haptic@49 {
        compatible = "immersion,isa1200-janice";
        reg = <0x49>;
        hen-gpios = <&gpio6 2 GPIO_ACTIVE_HIGH>;
        len-gpios = <&gpio6 3 GPIO_ACTIVE_HIGH>;
        clocks = <&clkout_clk>;
        isa1200,ldo-voltage = /bits/ 8 <30>;
        isa1200,clock-divider = /bits/ 16 <256>;
        isa1200,pll-divider = /bits/ 8 <2>;
        isa1200,pwm-frequency = /bits/ 8 <100>;
        isa1200,pwm-duty = /bits/ 8 <50>;
        isa1200,pwm-period = /bits/ 8 <100>;
      };
    };
```
