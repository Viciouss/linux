// SPDX-License-Identifier: GPL-2.0
/*
 * Samsung's Galaxy Note 10.1 - N801x (wifi only version)
 *
 * Copyright (c) 2013 Samsung Electronics Co., Ltd.
 *		http://www.samsung.com
 */

/dts-v1/;
#include "exynos4412-p4note.dtsi"

/ {
	model = "Samsung Galaxy Note 10.1 (GT-N8010/N8013) based on Exynos4412";
	compatible = "samsung,n8010", "samsung,p4note", "samsung,exynos4412", "samsung,exynos4";

	chosen {
		bootargs = "root=/dev/mmcblk2p9 rw ignore_loglevel earlyprintk init=/linuxrc androidboot.selinux=permissive androidboot.console=ttySAC2 androidboot.hardware=smdk4x12 no_console_suspend";
	};
};
