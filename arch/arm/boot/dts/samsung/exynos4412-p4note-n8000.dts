// SPDX-License-Identifier: GPL-2.0
/*
 * Samsung's Galaxy Note 10.1 - N801x (wifi only version)
 *
 * Copyright (c) 2013 Samsung Electronics Co., Ltd.
 *		http://www.samsung.com
 */

/dts-v1/;
#include "exynos4412-p4note.dtsi"

/ {
	model = "Samsung Galaxy Note 10.1 (GT-N8000) based on Exynos4412";
	compatible = "samsung,n8000", "samsung,p4note", "samsung,exynos4412", "samsung,exynos4";
	chassis-type = "tablet";

	chosen {
		bootargs = "root=/dev/mmcblk0p9 rw ignore_loglevel earlyprintk init=/linuxrc";
	};

	/* this is the 3g variant */
};
